! Generated by GenChem.py - DO NOT EDIT

  RC(1) = 5.67e-34*(TEMP/300.0)**(-2.8)*M*O2
  RC(2) = 0.21*3.2e-11*M*EXP(67.0*TINV)+0.79*1.8e-11*M*EXP(107.0*TINV)
  RC(3) = IUPAC_TROE(1.0e-31*EXP(1.6*LOG300DIVT),  &
        & 3.0e-11*EXP(-0.3*LOG300DIVT),  &
        & 0.85,  &
        & M,  &
        & 0.75-1.27*LOG10(0.85))
  RC(4) = 2.2e-10*H2O
  RC(5) = 1.4e-12*EXP(-1310.0*TINV)
  RC(6) = 1.4e-13*EXP(-2470.0*TINV)
  RC(7) = 1.7e-12*EXP(-940.0*TINV)
  RC(8) = 2.03e-16*EXP(-4.57*LOG300DIVT)*EXP(693.0*TINV)
  RC(9) = 1.8e-11*EXP(110.0*TINV)
  RC(10) = 3.6e-12*EXP(270.0*TINV)
  RC(11) = IUPAC_TROE(3.6e-30*EXP(4.1*LOG300DIVT),  &
         & 1.9e-12*EXP(-0.2*LOG300DIVT),  &
         & 0.35,  &
         & M,  &
         & 0.75-1.27*LOG10(0.35))
  RC(12) = IUPAC_TROE(3.3e-30*EXP(3.0*LOG300DIVT),  &
         & 4.1e-11,  &
         & 0.40,  &
         & M,  &
         & 0.75-1.27*LOG10(0.4))
  RC(13) = IUPAC_TROE(1.3e-3*EXP(3.5*LOG300DIVT)*EXP(-11000.0*TINV),  &
         & 9.70e14*EXP(-0.1*LOG300DIVT)*EXP(-11080.0*TINV),  &
         & 0.35,  &
         & M,  &
         & 0.75-1.27*LOG10(0.35))
  RC(14) = 7.7e-12*EXP(-2100.0*TINV)
  RC(15) = 4.8e-11*EXP(250.0*TINV)
  RC(16) = 2.9e-12*EXP(-160.0*TINV)
  RC(17) = (1.0+1.4e-21*H2O*EXP(2200.0*TINV))*2.2e-13*EXP(600.0*TINV)
  RC(18) = (1.0+1.4e-21*H2O*EXP(2200.0*TINV))*1.9e-33*EXP(980.0*TINV)*M
  RC(19) = KMT3(M,  &
         & TINV,  &
         & 2.4e-14,  &
         & 460.0,  &
         & 6.5e-34,  &
         & 1335.0,  &
         & 2.7e-17,  &
         & 2199.0)
  RC(20) = RC3B(4.0e-31*(TEMP/300.0)**(-3.3)*M,  &
         & 2.0e-12,  &
         & 0.45)
  RC(21) = 2.5e-12*EXP(-260.0*TINV)
  RC(22) = IUPAC_TROE(7.4e-31*EXP(2.4*LOG300DIVT),  &
         & 3.3e-11*EXP(0.3*LOG300DIVT),  &
         & EXP(-temp/1420.0),  &
         & M,  &
         & 0.75+3.884e-4*temp)
  RC(23) = 5.0e-6*M/2.55e19
  RC(24) = 1.85e-20*EXP(2.82*LOG(TEMP))*EXP(-987.0*TINV)
  RC(25) = 2.3e-12*EXP(360.0*TINV)
  RC(26) = 6.38e-18*(TEMP**2)*EXP(144.0*TINV)
  RC(27) = 3.8e-13*EXP(780.0*TINV)
  RC(28) = 1.0e-12*EXP(190.0*TINV)
  RC(29) = 1.9e-12*EXP(190.0*TINV)
  RC(30) = 1.25e-17*(TEMP**2)*EXP(615.0*TINV)
  RC(31) = 2.0e-12*EXP(-2440.0*TINV)
  RC(32) = 1.44e-13+M*3.43e-33
  RC(33) = 6.9e-12*EXP(-1000.0*TINV)
  RC(34) = 2.55e-12*EXP(380.0*TINV)
  RC(35) = 4.4e-12*EXP(365.0*TINV)
  RC(36) = IUPAC_TROE(2.7e-28*EXP(7.1*LOG300DIVT),  &
         & 1.2e-11*EXP(0.9*LOG300DIVT),  &
         & 0.3,  &
         & M,  &
         & 0.75-1.27*LOG10(0.3))
  RC(37) = IUPAC_TROE(4.9e-3*EXP(-12100.0*TINV),  &
         & 5.4e16*EXP(-13830.0*TINV),  &
         & 0.3,  &
         & M,  &
         & 0.75-1.27*LOG10(0.3))
  RC(38) = 7.5e-12*EXP(290.0*TINV)
  RC(39) = 6.7e-18*(TEMP**2)*EXP(511.0*TINV)
  RC(40) = 2.03e-17*(TEMP**2)*EXP(78.0*TINV)
  RC(41) = 2.54e-12*EXP(360.0*TINV)
  RC(42) = 2.53e-18*(TEMP**2)*EXP(503.0*TINV)
  RC(43) = IUPAC_TROE(8.6e-29*EXP(3.1*LOG300DIVT),  &
         & 9.0e-12*EXP(0.85*LOG300DIVT),  &
         & 0.48,  &
         & M,  &
         & 0.75-1.27*LOG10(0.48))
  RC(44) = 9.1e-15*EXP(-2580.0*TINV)
  RC(45) = IUPAC_TROE(8.0e-27*EXP(3.5*LOG300DIVT),  &
         & 3.0e-11*300.0*TINV,  &
         & 0.5,  &
         & M,  &
         & 0.75-1.27*LOG10(0.5))
  RC(46) = 5.5e-15*EXP(-1880.0*TINV)
  RC(47) = 1.9e-12*EXP(575.0*TINV)
  RC(48) = 6.6e-18*(TEMP**2)*EXP(820.0*TINV)
  RC(49) = 2.7e-11*EXP(390.0*TINV)
  RC(50) = 4.1e-12*EXP(453.0*TINV)
  RC(51) = 1.4e-12*EXP(-180.0*TINV)
