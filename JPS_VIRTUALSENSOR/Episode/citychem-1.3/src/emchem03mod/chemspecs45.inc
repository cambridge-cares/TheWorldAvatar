! Generated by GenChem.py - DO NOT EDIT


!+ Defines indices and M,O2,H2O :

integer, parameter :: M   =46
integer, parameter :: O2  =47
integer, parameter :: H2O =48

integer, parameter :: &
  OP          =   1  &
  , OD          =   2  &
  , OH          =   3  &
  , HO2         =   4  &
  , CH3O2       =   5  &
  , C2H5O2      =   6  &
  , secC4H9O2   =   7  &
  , IsopO2      =   8  &
  , CH2O2CH2OH  =   9  &
  , CH3CHO2CH2OH=  10

integer, parameter :: &
  oXylOHO2    =  11  &
  , CH3COCHO2CH3=  12  &
  , MemalO2     =  13  &
  , MVKO2       =  14  &
  , O3          =  15  &
  , NO          =  16  &
  , NO2         =  17  &
  , PAN         =  18  &
  , NO3         =  19  &
  , N2O5        =  20

integer, parameter :: &
  HNO3        =  21  &
  , HONO        =  22  &
  , CH3COO2     =  23  &
  , MVKetone    =  24  &
  , HCOCHO      =  25  &
  , CH3COCHO    =  26  &
  , Memaldial   =  27  &
  , CH3COC2H5   =  28  &
  , HCHO        =  29  &
  , CH3CHO      =  30

integer, parameter :: &
  C2H6        =  31  &
  , nC4H10      =  32  &
  , C2H4        =  33  &
  , C3H6        =  34  &
  , oXylene     =  35  &
  , Isoprene    =  36  &
  , CH3O2H      =  37  &
  , H2O2        =  38  &
  , CH3OH       =  39  &
  , C2H5OH      =  40

integer, parameter :: &
  H2          =  41  &
  , CO          =  42  &
  , CH4         =  43  &
  , SO2         =  44  &
  , Sulphate    =  45
  
  !+
  ! If zero timestep then we need to do nothing
  
  IF (DTP .LE. 0.) RETURN
  
  ! Set number of Gauss-Seidel iterations of the
  ! implicit Euler and the BDF second order method
  
  NrGSEul = 2
  NrGSBDF = 2
  
  ! Set absolute (mol/cm3) and relative (%/100) error
  ! tolerances
  
  DO NS = 1,NSPEC
    RTOL(NS) = 0.10
  ENDDO
  
  ATOLF = 1.0
  
  !+
  ! Assigns ATOL
  !+
  ATOL(OP          ) = 1.00e+15*ATOLF 
  ATOL(OD          ) = 1.00e+15*ATOLF 
  ATOL(OH          ) = 1.00e+15*ATOLF 
  ATOL(HO2         ) = 1.00e+15*ATOLF 
  ATOL(CH3O2       ) = 1.00e+15*ATOLF 
  ATOL(C2H5O2      ) = 1.00e+15*ATOLF 
  ATOL(secC4H9O2   ) = 1.00e+15*ATOLF 
  ATOL(IsopO2      ) = 1.00e+15*ATOLF 
  ATOL(CH2O2CH2OH  ) = 1.00e+15*ATOLF 
  ATOL(CH3CHO2CH2OH) = 1.00e+15*ATOLF 
  ATOL(oXylOHO2    ) = 1.00e+15*ATOLF 
  ATOL(CH3COCHO2CH3) = 1.00e+15*ATOLF 
  ATOL(MemalO2     ) = 1.00e+15*ATOLF 
  ATOL(MVKO2       ) = 1.00e+15*ATOLF 
  ATOL(O3          ) = 5.00e+10*ATOLF 
  ATOL(NO          ) = 2.50e+08*ATOLF 
  ATOL(NO2         ) = 2.50e+09*ATOLF 
  ATOL(PAN         ) = 2.50e+09*ATOLF 
  ATOL(NO3         ) = 1.00e+15*ATOLF 
  ATOL(N2O5        ) = 1.00e+15*ATOLF 
  ATOL(HNO3        ) = 2.50e+08*ATOLF 
  ATOL(HONO        ) = 1.00e+15*ATOLF 
  ATOL(CH3COO2     ) = 1.00e+15*ATOLF 
  ATOL(MVKetone    ) = 1.00e+15*ATOLF 
  ATOL(HCOCHO      ) = 1.00e+15*ATOLF 
  ATOL(CH3COCHO    ) = 1.00e+15*ATOLF 
  ATOL(Memaldial   ) = 1.00e+15*ATOLF 
  ATOL(CH3COC2H5   ) = 1.00e+15*ATOLF 
  ATOL(HCHO        ) = 2.50e+09*ATOLF 
  ATOL(CH3CHO      ) = 2.50e+09*ATOLF 
  ATOL(C2H6        ) = 5.00e+09*ATOLF 
  ATOL(nC4H10      ) = 5.00e+09*ATOLF 
  ATOL(C2H4        ) = 2.50e+09*ATOLF 
  ATOL(C3H6        ) = 2.50e+09*ATOLF 
  ATOL(oXylene     ) = 2.50e+09*ATOLF 
  ATOL(Isoprene    ) = 2.50e+08*ATOLF 
  ATOL(CH3O2H      ) = 2.50e+09*ATOLF 
  ATOL(H2O2        ) = 2.50e+09*ATOLF 
  ATOL(CH3OH       ) = 2.50e+09*ATOLF 
  ATOL(C2H5OH      ) = 2.50e+09*ATOLF 
  ATOL(H2          ) = 1.00e+15*ATOLF 
  ATOL(CO          ) = 1.00e+15*ATOLF 
  ATOL(CH4         ) = 1.00e+15*ATOLF 
  ATOL(SO2         ) = 2.50e+09*ATOLF 
  ATOL(Sulphate    ) = 2.50e+09*ATOLF 
