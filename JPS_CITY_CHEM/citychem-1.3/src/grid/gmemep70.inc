! Generated by GenChem.py - DO NOT EDIT

  
  !+
  do IC = 1, NC
  
    if (cmpnd(ic)   == "OP          ")   CP(   1) = C(IC,IX+1,IY+1,IZ)*((avogad*1.e-12)/cmolw(ic))   
    if (cmpnd(ic)   == "OD          ")   CP(   2) = C(IC,IX+1,IY+1,IZ)*((avogad*1.e-12)/cmolw(ic))   
    if (cmpnd(ic)   == "OH          ")   CP(   3) = C(IC,IX+1,IY+1,IZ)*((avogad*1.e-12)/cmolw(ic))   
    if (cmpnd(ic)   == "HO2         ")   CP(   4) = C(IC,IX+1,IY+1,IZ)*((avogad*1.e-12)/cmolw(ic))   
    if (cmpnd(ic)   == "CH3O2       ")   CP(   5) = C(IC,IX+1,IY+1,IZ)*((avogad*1.e-12)/cmolw(ic))   
    if (cmpnd(ic)   == "C2H5O2      ")   CP(   6) = C(IC,IX+1,IY+1,IZ)*((avogad*1.e-12)/cmolw(ic))   
    if (cmpnd(ic)   == "secC4H9O2   ")   CP(   7) = C(IC,IX+1,IY+1,IZ)*((avogad*1.e-12)/cmolw(ic))   
    if (cmpnd(ic)   == "IsopO2      ")   CP(   8) = C(IC,IX+1,IY+1,IZ)*((avogad*1.e-12)/cmolw(ic))   
    if (cmpnd(ic)   == "CH2O2CH2OH  ")   CP(   9) = C(IC,IX+1,IY+1,IZ)*((avogad*1.e-12)/cmolw(ic))   
    if (cmpnd(ic)   == "CH3CHO2CH2OH")   CP(  10) = C(IC,IX+1,IY+1,IZ)*((avogad*1.e-12)/cmolw(ic))   
    if (cmpnd(ic)   == "oXylOHO2    ")   CP(  11) = C(IC,IX+1,IY+1,IZ)*((avogad*1.e-12)/cmolw(ic))   
    if (cmpnd(ic)   == "CH3COCHO2CH3")   CP(  12) = C(IC,IX+1,IY+1,IZ)*((avogad*1.e-12)/cmolw(ic))   
    if (cmpnd(ic)   == "MemalO2     ")   CP(  13) = C(IC,IX+1,IY+1,IZ)*((avogad*1.e-12)/cmolw(ic))   
    if (cmpnd(ic)   == "MVKO2       ")   CP(  14) = C(IC,IX+1,IY+1,IZ)*((avogad*1.e-12)/cmolw(ic))   
    if (cmpnd(ic)   == "MTO2        ")   CP(  15) = C(IC,IX+1,IY+1,IZ)*((avogad*1.e-12)/cmolw(ic))   
    if (cmpnd(ic)   == "O3          ")   CP(  16) = C(IC,IX+1,IY+1,IZ)*((avogad*1.e-12)/cmolw(ic))   
    if (cmpnd(ic)   == "NO          ")   CP(  17) = C(IC,IX+1,IY+1,IZ)*((avogad*1.e-12)/cmolw(ic))   
    if (cmpnd(ic)   == "NO2         ")   CP(  18) = C(IC,IX+1,IY+1,IZ)*((avogad*1.e-12)/cmolw(ic))   
    if (cmpnd(ic)   == "PAN         ")   CP(  19) = C(IC,IX+1,IY+1,IZ)*((avogad*1.e-12)/cmolw(ic))   
    if (cmpnd(ic)   == "NO3         ")   CP(  20) = C(IC,IX+1,IY+1,IZ)*((avogad*1.e-12)/cmolw(ic))   
    if (cmpnd(ic)   == "N2O5        ")   CP(  21) = C(IC,IX+1,IY+1,IZ)*((avogad*1.e-12)/cmolw(ic))   
    if (cmpnd(ic)   == "HNO3        ")   CP(  22) = C(IC,IX+1,IY+1,IZ)*((avogad*1.e-12)/cmolw(ic))   
    if (cmpnd(ic)   == "HONO        ")   CP(  23) = C(IC,IX+1,IY+1,IZ)*((avogad*1.e-12)/cmolw(ic))   
    if (cmpnd(ic)   == "CH3COO2     ")   CP(  24) = C(IC,IX+1,IY+1,IZ)*((avogad*1.e-12)/cmolw(ic))   
    if (cmpnd(ic)   == "MVKetone    ")   CP(  25) = C(IC,IX+1,IY+1,IZ)*((avogad*1.e-12)/cmolw(ic))   
    if (cmpnd(ic)   == "HCOCHO      ")   CP(  26) = C(IC,IX+1,IY+1,IZ)*((avogad*1.e-12)/cmolw(ic))   
    if (cmpnd(ic)   == "CH3COCHO    ")   CP(  27) = C(IC,IX+1,IY+1,IZ)*((avogad*1.e-12)/cmolw(ic))   
    if (cmpnd(ic)   == "Memaldial   ")   CP(  28) = C(IC,IX+1,IY+1,IZ)*((avogad*1.e-12)/cmolw(ic))   
    if (cmpnd(ic)   == "CH3COC2H5   ")   CP(  29) = C(IC,IX+1,IY+1,IZ)*((avogad*1.e-12)/cmolw(ic))   
    if (cmpnd(ic)   == "MTKetone    ")   CP(  30) = C(IC,IX+1,IY+1,IZ)*((avogad*1.e-12)/cmolw(ic))   
    if (cmpnd(ic)   == "ProdApinO3  ")   CP(  31) = C(IC,IX+1,IY+1,IZ)*((avogad*1.e-12)/cmolw(ic))   
    if (cmpnd(ic)   == "ProdApinNO3 ")   CP(  32) = C(IC,IX+1,IY+1,IZ)*((avogad*1.e-12)/cmolw(ic))   
    if (cmpnd(ic)   == "ProdApinOH  ")   CP(  33) = C(IC,IX+1,IY+1,IZ)*((avogad*1.e-12)/cmolw(ic))   
    if (cmpnd(ic)   == "ProdLimoO3  ")   CP(  34) = C(IC,IX+1,IY+1,IZ)*((avogad*1.e-12)/cmolw(ic))   
    if (cmpnd(ic)   == "ProdLimoNO3 ")   CP(  35) = C(IC,IX+1,IY+1,IZ)*((avogad*1.e-12)/cmolw(ic))   
    if (cmpnd(ic)   == "ProdLimoOH  ")   CP(  36) = C(IC,IX+1,IY+1,IZ)*((avogad*1.e-12)/cmolw(ic))   
    if (cmpnd(ic)   == "HCHO        ")   CP(  37) = C(IC,IX+1,IY+1,IZ)*((avogad*1.e-12)/cmolw(ic))   
    if (cmpnd(ic)   == "CH3CHO      ")   CP(  38) = C(IC,IX+1,IY+1,IZ)*((avogad*1.e-12)/cmolw(ic))   
    if (cmpnd(ic)   == "C2H6        ")   CP(  39) = C(IC,IX+1,IY+1,IZ)*((avogad*1.e-12)/cmolw(ic))   
    if (cmpnd(ic)   == "nC4H10      ")   CP(  40) = C(IC,IX+1,IY+1,IZ)*((avogad*1.e-12)/cmolw(ic))   
    if (cmpnd(ic)   == "C2H4        ")   CP(  41) = C(IC,IX+1,IY+1,IZ)*((avogad*1.e-12)/cmolw(ic))   
    if (cmpnd(ic)   == "C3H6        ")   CP(  42) = C(IC,IX+1,IY+1,IZ)*((avogad*1.e-12)/cmolw(ic))   
    if (cmpnd(ic)   == "oXylene     ")   CP(  43) = C(IC,IX+1,IY+1,IZ)*((avogad*1.e-12)/cmolw(ic))   
    if (cmpnd(ic)   == "Isoprene    ")   CP(  44) = C(IC,IX+1,IY+1,IZ)*((avogad*1.e-12)/cmolw(ic))   
    if (cmpnd(ic)   == "Apinene     ")   CP(  45) = C(IC,IX+1,IY+1,IZ)*((avogad*1.e-12)/cmolw(ic))   
    if (cmpnd(ic)   == "Limonene    ")   CP(  46) = C(IC,IX+1,IY+1,IZ)*((avogad*1.e-12)/cmolw(ic))   
    if (cmpnd(ic)   == "CH3O2H      ")   CP(  47) = C(IC,IX+1,IY+1,IZ)*((avogad*1.e-12)/cmolw(ic))   
    if (cmpnd(ic)   == "C2H5OOH     ")   CP(  48) = C(IC,IX+1,IY+1,IZ)*((avogad*1.e-12)/cmolw(ic))   
    if (cmpnd(ic)   == "BURO2H      ")   CP(  49) = C(IC,IX+1,IY+1,IZ)*((avogad*1.e-12)/cmolw(ic))   
    if (cmpnd(ic)   == "ETRO2H      ")   CP(  50) = C(IC,IX+1,IY+1,IZ)*((avogad*1.e-12)/cmolw(ic))   
    if (cmpnd(ic)   == "PRRO2H      ")   CP(  51) = C(IC,IX+1,IY+1,IZ)*((avogad*1.e-12)/cmolw(ic))   
    if (cmpnd(ic)   == "OXYO2H      ")   CP(  52) = C(IC,IX+1,IY+1,IZ)*((avogad*1.e-12)/cmolw(ic))   
    if (cmpnd(ic)   == "MEKO2H      ")   CP(  53) = C(IC,IX+1,IY+1,IZ)*((avogad*1.e-12)/cmolw(ic))   
    if (cmpnd(ic)   == "MemalO2H    ")   CP(  54) = C(IC,IX+1,IY+1,IZ)*((avogad*1.e-12)/cmolw(ic))   
    if (cmpnd(ic)   == "MVKO2H      ")   CP(  55) = C(IC,IX+1,IY+1,IZ)*((avogad*1.e-12)/cmolw(ic))   
    if (cmpnd(ic)   == "ISRO2H      ")   CP(  56) = C(IC,IX+1,IY+1,IZ)*((avogad*1.e-12)/cmolw(ic))   
    if (cmpnd(ic)   == "MTO2H       ")   CP(  57) = C(IC,IX+1,IY+1,IZ)*((avogad*1.e-12)/cmolw(ic))   
    if (cmpnd(ic)   == "H2O2        ")   CP(  58) = C(IC,IX+1,IY+1,IZ)*((avogad*1.e-12)/cmolw(ic))   
    if (cmpnd(ic)   == "CH3COO2H    ")   CP(  59) = C(IC,IX+1,IY+1,IZ)*((avogad*1.e-12)/cmolw(ic))   
    if (cmpnd(ic)   == "CH3OH       ")   CP(  60) = C(IC,IX+1,IY+1,IZ)*((avogad*1.e-12)/cmolw(ic))   
    if (cmpnd(ic)   == "C2H5OH      ")   CP(  61) = C(IC,IX+1,IY+1,IZ)*((avogad*1.e-12)/cmolw(ic))   
    if (cmpnd(ic)   == "CH3COCH2OH  ")   CP(  62) = C(IC,IX+1,IY+1,IZ)*((avogad*1.e-12)/cmolw(ic))   
    if (cmpnd(ic)   == "H2          ")   CP(  63) = C(IC,IX+1,IY+1,IZ)*((avogad*1.e-12)/cmolw(ic))   
    if (cmpnd(ic)   == "CO          ")   CP(  64) = C(IC,IX+1,IY+1,IZ)*((avogad*1.e-12)/cmolw(ic))   
    if (cmpnd(ic)   == "CH4         ")   CP(  65) = C(IC,IX+1,IY+1,IZ)*((avogad*1.e-12)/cmolw(ic))   
    if (cmpnd(ic)   == "SO2         ")   CP(  66) = C(IC,IX+1,IY+1,IZ)*((avogad*1.e-12)/cmolw(ic))   
    if (cmpnd(ic)   == "Sulphate    ")   CP(  67) = C(IC,IX+1,IY+1,IZ)*((avogad*1.e-12)/cmolw(ic))   
    if (cmpnd(ic)   == "BLOC        ")   CP(  68) = C(IC,IX+1,IY+1,IZ)*((avogad*1.e-12)/cmolw(ic))   
    if (cmpnd(ic)   == "BSOC        ")   CP(  69) = C(IC,IX+1,IY+1,IZ)*((avogad*1.e-12)/cmolw(ic))   
    if (cmpnd(ic)   == "ALOC        ")   CP(  70) = C(IC,IX+1,IY+1,IZ)*((avogad*1.e-12)/cmolw(ic))  
  
  
  enddo
  !
  !+
  CALL EMEP70BIO(DTP,MSPEC,NSPEC,CP,                                &
                  SITELAV,SITELOV,IX,IY,IZ,                         &
                  YEARV,MNTHV,DAYMV,HOURV,MINUV,SECOV,DAYYV,        & 
                  pimeteexternaldata ,TAIRV,DTDZV,RHUMV,SHUMV,      &
                  PRESV,PRECV,CLOUV,TSRADV,MOBULV,USTARV,           &
                  HINVD,HINVW,IDRY,ILAND,                           &
                  JNO2V,JO3V,RC1V,RC3V,RC5V,RC6V,RC11V,RC32V,RC36V)
  
  ! *** Copy Concentrations back
  !
  ! Convert from molec/cm3 to ug/m3
  ! C(ic) = CP(ic)*cmolw(ic)/(avogad*1.e-12)
  !+
  do IC = 1, NC
  
    if (cmpnd(ic)   == "OP          ")   C(IC,IX+1,IY+1,IZ)  = CP(   1)*cmolw(ic)/(avogad*1.e-12)   
    if (cmpnd(ic)   == "OD          ")   C(IC,IX+1,IY+1,IZ)  = CP(   2)*cmolw(ic)/(avogad*1.e-12)   
    if (cmpnd(ic)   == "OH          ")   C(IC,IX+1,IY+1,IZ)  = CP(   3)*cmolw(ic)/(avogad*1.e-12)   
    if (cmpnd(ic)   == "HO2         ")   C(IC,IX+1,IY+1,IZ)  = CP(   4)*cmolw(ic)/(avogad*1.e-12)   
    if (cmpnd(ic)   == "CH3O2       ")   C(IC,IX+1,IY+1,IZ)  = CP(   5)*cmolw(ic)/(avogad*1.e-12)   
    if (cmpnd(ic)   == "C2H5O2      ")   C(IC,IX+1,IY+1,IZ)  = CP(   6)*cmolw(ic)/(avogad*1.e-12)   
    if (cmpnd(ic)   == "secC4H9O2   ")   C(IC,IX+1,IY+1,IZ)  = CP(   7)*cmolw(ic)/(avogad*1.e-12)   
    if (cmpnd(ic)   == "IsopO2      ")   C(IC,IX+1,IY+1,IZ)  = CP(   8)*cmolw(ic)/(avogad*1.e-12)   
    if (cmpnd(ic)   == "CH2O2CH2OH  ")   C(IC,IX+1,IY+1,IZ)  = CP(   9)*cmolw(ic)/(avogad*1.e-12)   
    if (cmpnd(ic)   == "CH3CHO2CH2OH")   C(IC,IX+1,IY+1,IZ)  = CP(  10)*cmolw(ic)/(avogad*1.e-12)   
    if (cmpnd(ic)   == "oXylOHO2    ")   C(IC,IX+1,IY+1,IZ)  = CP(  11)*cmolw(ic)/(avogad*1.e-12)   
    if (cmpnd(ic)   == "CH3COCHO2CH3")   C(IC,IX+1,IY+1,IZ)  = CP(  12)*cmolw(ic)/(avogad*1.e-12)   
    if (cmpnd(ic)   == "MemalO2     ")   C(IC,IX+1,IY+1,IZ)  = CP(  13)*cmolw(ic)/(avogad*1.e-12)   
    if (cmpnd(ic)   == "MVKO2       ")   C(IC,IX+1,IY+1,IZ)  = CP(  14)*cmolw(ic)/(avogad*1.e-12)   
    if (cmpnd(ic)   == "MTO2        ")   C(IC,IX+1,IY+1,IZ)  = CP(  15)*cmolw(ic)/(avogad*1.e-12)   
    if (cmpnd(ic)   == "O3          ")   C(IC,IX+1,IY+1,IZ)  = CP(  16)*cmolw(ic)/(avogad*1.e-12)   
    if (cmpnd(ic)   == "NO          ")   C(IC,IX+1,IY+1,IZ)  = CP(  17)*cmolw(ic)/(avogad*1.e-12)   
    if (cmpnd(ic)   == "NO2         ")   C(IC,IX+1,IY+1,IZ)  = CP(  18)*cmolw(ic)/(avogad*1.e-12)   
    if (cmpnd(ic)   == "PAN         ")   C(IC,IX+1,IY+1,IZ)  = CP(  19)*cmolw(ic)/(avogad*1.e-12)   
    if (cmpnd(ic)   == "NO3         ")   C(IC,IX+1,IY+1,IZ)  = CP(  20)*cmolw(ic)/(avogad*1.e-12)   
    if (cmpnd(ic)   == "N2O5        ")   C(IC,IX+1,IY+1,IZ)  = CP(  21)*cmolw(ic)/(avogad*1.e-12)   
    if (cmpnd(ic)   == "HNO3        ")   C(IC,IX+1,IY+1,IZ)  = CP(  22)*cmolw(ic)/(avogad*1.e-12)   
    if (cmpnd(ic)   == "HONO        ")   C(IC,IX+1,IY+1,IZ)  = CP(  23)*cmolw(ic)/(avogad*1.e-12)   
    if (cmpnd(ic)   == "CH3COO2     ")   C(IC,IX+1,IY+1,IZ)  = CP(  24)*cmolw(ic)/(avogad*1.e-12)   
    if (cmpnd(ic)   == "MVKetone    ")   C(IC,IX+1,IY+1,IZ)  = CP(  25)*cmolw(ic)/(avogad*1.e-12)   
    if (cmpnd(ic)   == "HCOCHO      ")   C(IC,IX+1,IY+1,IZ)  = CP(  26)*cmolw(ic)/(avogad*1.e-12)   
    if (cmpnd(ic)   == "CH3COCHO    ")   C(IC,IX+1,IY+1,IZ)  = CP(  27)*cmolw(ic)/(avogad*1.e-12)   
    if (cmpnd(ic)   == "Memaldial   ")   C(IC,IX+1,IY+1,IZ)  = CP(  28)*cmolw(ic)/(avogad*1.e-12)   
    if (cmpnd(ic)   == "CH3COC2H5   ")   C(IC,IX+1,IY+1,IZ)  = CP(  29)*cmolw(ic)/(avogad*1.e-12)   
    if (cmpnd(ic)   == "MTKetone    ")   C(IC,IX+1,IY+1,IZ)  = CP(  30)*cmolw(ic)/(avogad*1.e-12)   
    if (cmpnd(ic)   == "ProdApinO3  ")   C(IC,IX+1,IY+1,IZ)  = CP(  31)*cmolw(ic)/(avogad*1.e-12)   
    if (cmpnd(ic)   == "ProdApinNO3 ")   C(IC,IX+1,IY+1,IZ)  = CP(  32)*cmolw(ic)/(avogad*1.e-12)   
    if (cmpnd(ic)   == "ProdApinOH  ")   C(IC,IX+1,IY+1,IZ)  = CP(  33)*cmolw(ic)/(avogad*1.e-12)   
    if (cmpnd(ic)   == "ProdLimoO3  ")   C(IC,IX+1,IY+1,IZ)  = CP(  34)*cmolw(ic)/(avogad*1.e-12)   
    if (cmpnd(ic)   == "ProdLimoNO3 ")   C(IC,IX+1,IY+1,IZ)  = CP(  35)*cmolw(ic)/(avogad*1.e-12)   
    if (cmpnd(ic)   == "ProdLimoOH  ")   C(IC,IX+1,IY+1,IZ)  = CP(  36)*cmolw(ic)/(avogad*1.e-12)   
    if (cmpnd(ic)   == "HCHO        ")   C(IC,IX+1,IY+1,IZ)  = CP(  37)*cmolw(ic)/(avogad*1.e-12)   
    if (cmpnd(ic)   == "CH3CHO      ")   C(IC,IX+1,IY+1,IZ)  = CP(  38)*cmolw(ic)/(avogad*1.e-12)   
    if (cmpnd(ic)   == "C2H6        ")   C(IC,IX+1,IY+1,IZ)  = CP(  39)*cmolw(ic)/(avogad*1.e-12)   
    if (cmpnd(ic)   == "nC4H10      ")   C(IC,IX+1,IY+1,IZ)  = CP(  40)*cmolw(ic)/(avogad*1.e-12)   
    if (cmpnd(ic)   == "C2H4        ")   C(IC,IX+1,IY+1,IZ)  = CP(  41)*cmolw(ic)/(avogad*1.e-12)   
    if (cmpnd(ic)   == "C3H6        ")   C(IC,IX+1,IY+1,IZ)  = CP(  42)*cmolw(ic)/(avogad*1.e-12)   
    if (cmpnd(ic)   == "oXylene     ")   C(IC,IX+1,IY+1,IZ)  = CP(  43)*cmolw(ic)/(avogad*1.e-12)   
    if (cmpnd(ic)   == "Isoprene    ")   C(IC,IX+1,IY+1,IZ)  = CP(  44)*cmolw(ic)/(avogad*1.e-12)   
    if (cmpnd(ic)   == "Apinene     ")   C(IC,IX+1,IY+1,IZ)  = CP(  45)*cmolw(ic)/(avogad*1.e-12)   
    if (cmpnd(ic)   == "Limonene    ")   C(IC,IX+1,IY+1,IZ)  = CP(  46)*cmolw(ic)/(avogad*1.e-12)   
    if (cmpnd(ic)   == "CH3O2H      ")   C(IC,IX+1,IY+1,IZ)  = CP(  47)*cmolw(ic)/(avogad*1.e-12)   
    if (cmpnd(ic)   == "C2H5OOH     ")   C(IC,IX+1,IY+1,IZ)  = CP(  48)*cmolw(ic)/(avogad*1.e-12)   
    if (cmpnd(ic)   == "BURO2H      ")   C(IC,IX+1,IY+1,IZ)  = CP(  49)*cmolw(ic)/(avogad*1.e-12)   
    if (cmpnd(ic)   == "ETRO2H      ")   C(IC,IX+1,IY+1,IZ)  = CP(  50)*cmolw(ic)/(avogad*1.e-12)   
    if (cmpnd(ic)   == "PRRO2H      ")   C(IC,IX+1,IY+1,IZ)  = CP(  51)*cmolw(ic)/(avogad*1.e-12)   
    if (cmpnd(ic)   == "OXYO2H      ")   C(IC,IX+1,IY+1,IZ)  = CP(  52)*cmolw(ic)/(avogad*1.e-12)   
    if (cmpnd(ic)   == "MEKO2H      ")   C(IC,IX+1,IY+1,IZ)  = CP(  53)*cmolw(ic)/(avogad*1.e-12)   
    if (cmpnd(ic)   == "MemalO2H    ")   C(IC,IX+1,IY+1,IZ)  = CP(  54)*cmolw(ic)/(avogad*1.e-12)   
    if (cmpnd(ic)   == "MVKO2H      ")   C(IC,IX+1,IY+1,IZ)  = CP(  55)*cmolw(ic)/(avogad*1.e-12)   
    if (cmpnd(ic)   == "ISRO2H      ")   C(IC,IX+1,IY+1,IZ)  = CP(  56)*cmolw(ic)/(avogad*1.e-12)   
    if (cmpnd(ic)   == "MTO2H       ")   C(IC,IX+1,IY+1,IZ)  = CP(  57)*cmolw(ic)/(avogad*1.e-12)   
    if (cmpnd(ic)   == "H2O2        ")   C(IC,IX+1,IY+1,IZ)  = CP(  58)*cmolw(ic)/(avogad*1.e-12)   
    if (cmpnd(ic)   == "CH3COO2H    ")   C(IC,IX+1,IY+1,IZ)  = CP(  59)*cmolw(ic)/(avogad*1.e-12)   
    if (cmpnd(ic)   == "CH3OH       ")   C(IC,IX+1,IY+1,IZ)  = CP(  60)*cmolw(ic)/(avogad*1.e-12)   
    if (cmpnd(ic)   == "C2H5OH      ")   C(IC,IX+1,IY+1,IZ)  = CP(  61)*cmolw(ic)/(avogad*1.e-12)   
    if (cmpnd(ic)   == "CH3COCH2OH  ")   C(IC,IX+1,IY+1,IZ)  = CP(  62)*cmolw(ic)/(avogad*1.e-12)   
    if (cmpnd(ic)   == "H2          ")   C(IC,IX+1,IY+1,IZ)  = CP(  63)*cmolw(ic)/(avogad*1.e-12)   
    if (cmpnd(ic)   == "CO          ")   C(IC,IX+1,IY+1,IZ)  = CP(  64)*cmolw(ic)/(avogad*1.e-12)   
    if (cmpnd(ic)   == "CH4         ")   C(IC,IX+1,IY+1,IZ)  = CP(  65)*cmolw(ic)/(avogad*1.e-12)   
    if (cmpnd(ic)   == "SO2         ")   C(IC,IX+1,IY+1,IZ)  = CP(  66)*cmolw(ic)/(avogad*1.e-12)   
    if (cmpnd(ic)   == "Sulphate    ")   C(IC,IX+1,IY+1,IZ)  = CP(  67)*cmolw(ic)/(avogad*1.e-12)   
    if (cmpnd(ic)   == "BLOC        ")   C(IC,IX+1,IY+1,IZ)  = CP(  68)*cmolw(ic)/(avogad*1.e-12)   
    if (cmpnd(ic)   == "BSOC        ")   C(IC,IX+1,IY+1,IZ)  = CP(  69)*cmolw(ic)/(avogad*1.e-12)   
    if (cmpnd(ic)   == "ALOC        ")   C(IC,IX+1,IY+1,IZ)  = CP(  70)*cmolw(ic)/(avogad*1.e-12)  
  
  
  enddo    ! copy back concentrations
  !
  !+
