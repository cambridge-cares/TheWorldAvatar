! Generated by GenChem.py - DO NOT EDIT

!-> OP

  P = RC(2) * X(OD,1)  &
    + DJ(2) * X(O3,1)  &
    + DJ(3) * X(NO2,1)  &
    + DJ(14) * X(NO3,1)
  
  L = RC(1)  &
    + RC(3) * X(NO,1)
  
  F(OP)= P - L*X(OP,1)


!-> OD

  P = DJ(1) * X(O3,1)
  
  L = RC(2)  &
    + RC(4)
  
  F(OD)= P - L*X(OD,1)


!-> OH

  P = 2.* RC(4) * X(OD,1)  &
    + RC(8) * X(O3,1) * X(HO2,1)  &
    + RC(10) * X(NO,1) * X(HO2,1)  &
    + 3.5e-12 * X(NO3,1) * X(HO2,1)  &
    + RC(28) * X(CH3O2H,1) * X(OH,1)  &
    + 0.13* RC(44) * X(C2H4,1) * X(O3,1)  &
    + 0.36* RC(46) * X(O3,1) * X(C3H6,1)  &
    + 2* DJ(4) * X(H2O2,1)  &
    + DJ(5) * X(HNO3,1)  &
    + DJ(16) * X(CH3O2H,1)  &
    + DJ(17) * X(HONO,1)
  
  L = RC(7) * X(O3,1)  &
    + RC(12) * X(NO2,1)  &
    + RC(14) * X(H2,1)  &
    + RC(15) * X(HO2,1)  &
    + RC(16) * X(H2O2,1)  &
    + RC(19) * X(HNO3,1)  &
    + RC(20) * X(SO2,1)  &
    + RC(21) * X(HONO,1)  &
    + RC(22) * X(NO,1)  &
    + RC(24) * X(CH4,1)  &
    + RC(26) * X(CH3OH,1)  &
    + RC(28) * X(CH3O2H,1)  &
    + RC(29) * X(CH3O2H,1)  &
    + RC(30) * X(HCHO,1)  &
    + RC(32) * X(CO,1)  &
    + RC(33) * X(C2H6,1)  &
    + RC(35) * X(CH3CHO,1)  &
    + RC(39) * X(C2H5OH,1)  &
    + RC(40) * X(nC4H10,1)  &
    + RC(42) * X(CH3COC2H5,1)  &
    + RC(43) * X(C2H4,1)  &
    + RC(45) * X(C3H6,1)  &
    + 1.36e-11 * X(oXylene,1)  &
    + 5.58e-11 * X(Memaldial,1)  &
    + RC(47) * X(CH3COCHO,1)  &
    + RC(48) * X(HCOCHO,1)  &
    + RC(49) * X(Isoprene,1)  &
    + RC(50) * X(MVKetone,1)
  
  F(OH)= P - L*X(OH,1)


!-> HO2

  P = RC(7) * X(O3,1) * X(OH,1)  &
    + RC(14) * X(OH,1) * X(H2,1)  &
    + RC(16) * X(OH,1) * X(H2O2,1)  &
    + RC(20) * X(SO2,1) * X(OH,1)  &
    + 4.0e-17 * X(SO2,1) * X(CH3O2,1)  &
    + RC(25) * X(CH3O2,1) * X(NO,1)  &
    + 1.3e-12 * X(CH3O2,1) * X(NO3,1)  &
    + RC(26) * X(OH,1) * X(CH3OH,1)  &
    + RC(30) * X(OH,1) * X(HCHO,1)  &
    + RC(31) * X(NO3,1) * X(HCHO,1)  &
    + RC(32) * X(OH,1) * X(CO,1)  &
    + RC(34) * X(C2H5O2,1) * X(NO,1)  &
    + 2.3e-12 * X(C2H5O2,1) * X(NO3,1)  &
    + RC(39) * X(OH,1) * X(C2H5OH,1)  &
    + 0.65* RC(41) * X(NO,1) * X(secC4H9O2,1)  &
    + RC(41) * X(CH2O2CH2OH,1) * X(NO,1)  &
    + 0.13* RC(44) * X(C2H4,1) * X(O3,1)  &
    + RC(41) * X(NO,1) * X(CH3CHO2CH2OH,1)  &
    + 0.28* RC(46) * X(O3,1) * X(C3H6,1)  &
    + RC(41) * X(oXylOHO2,1) * X(NO,1)  &
    + RC(41) * X(MemalO2,1) * X(NO,1)  &
    + RC(48) * X(OH,1) * X(HCOCHO,1)  &
    + RC(41) * X(IsopO2,1) * X(NO,1)  &
    + RC(51) * X(MVKO2,1) * X(NO,1)  &
    + 2* DJ(6) * X(HCHO,1)  &
    + DJ(8) * X(CH3CHO,1)  &
    + DJ(11) * X(CH3COCHO,1)  &
    + 0.5* DJ(12) * X(HCOCHO,1)  &
    + DJ(16) * X(CH3O2H,1)
  
  L = RC(8) * X(O3,1)  &
    + RC(10) * X(NO,1)  &
    + 3.5e-12 * X(NO3,1)  &
    + RC(15) * X(OH,1)  &
    + RC(17) * X(HO2,1)  &
    + RC(17) * X(HO2,1)  &
    + RC(18) * X(HO2,1)  &
    + RC(18) * X(HO2,1)  &
    + RC(27) * X(CH3O2,1)
  
  F(HO2)= P - L*X(HO2,1)


!-> CH3O2

  P = RC(24) * X(OH,1) * X(CH4,1)  &
    + RC(29) * X(CH3O2H,1) * X(OH,1)  &
    + 0.05* RC(35) * X(OH,1) * X(CH3CHO,1)  &
    + RC(38) * X(CH3COO2,1) * X(NO,1)  &
    + 0.28* RC(46) * X(O3,1) * X(C3H6,1)  &
    + DJ(8) * X(CH3CHO,1)
  
  L = 4.0e-17 * X(SO2,1)  &
    + RC(25) * X(NO,1)  &
    + 1.3e-12 * X(NO3,1)  &
    + RC(27) * X(HO2,1)
  
  F(CH3O2)= P - L*X(CH3O2,1)


!-> C2H5O2

  P = RC(33) * X(OH,1) * X(C2H6,1)  &
    + 0.35* RC(41) * X(NO,1) * X(secC4H9O2,1)  &
    + DJ(9) * X(CH3COC2H5,1)
  
  L = RC(34) * X(NO,1)  &
    + 2.3e-12 * X(NO3,1)
  
  F(C2H5O2)= P - L*X(C2H5O2,1)


!-> secC4H9O2

  P = RC(40) * X(OH,1) * X(nC4H10,1)
  
  L = RC(41) * X(NO,1)
  
  F(secC4H9O2)= P - L*X(secC4H9O2,1)


!-> IsopO2

  P = RC(49) * X(Isoprene,1) * X(OH,1)
  
  L = RC(41) * X(NO,1)
  
  F(IsopO2)= P - L*X(IsopO2,1)


!-> CH2O2CH2OH

  P = RC(43) * X(C2H4,1) * X(OH,1)
  
  L = RC(41) * X(NO,1)
  
  F(CH2O2CH2OH)= P - L*X(CH2O2CH2OH,1)


!-> CH3CHO2CH2OH

  P = RC(45) * X(OH,1) * X(C3H6,1)
  
  L = RC(41) * X(NO,1)
  
  F(CH3CHO2CH2OH)= P - L*X(CH3CHO2CH2OH,1)


!-> oXylOHO2

  P = 1.36e-11 * X(oXylene,1) * X(OH,1)
  
  L = RC(41) * X(NO,1)
  
  F(oXylOHO2)= P - L*X(oXylOHO2,1)


!-> CH3COCHO2CH3

  P = RC(42) * X(OH,1) * X(CH3COC2H5,1)
  
  L = RC(41) * X(NO,1)
  
  F(CH3COCHO2CH3)= P - L*X(CH3COCHO2CH3,1)


!-> MemalO2

  P = 5.58e-11 * X(Memaldial,1) * X(OH,1)
  
  L = RC(41) * X(NO,1)
  
  F(MemalO2)= P - L*X(MemalO2,1)


!-> MVKO2

  P = RC(50) * X(MVKetone,1) * X(OH,1)
  
  L = RC(51) * X(NO,1)
  
  F(MVKO2)= P - L*X(MVKO2,1)


!-> O3

  P = RC(1) * X(OP,1)
  
  L = RC(5) * X(NO,1)  &
    + RC(6) * X(NO2,1)  &
    + RC(7) * X(OH,1)  &
    + RC(8) * X(HO2,1)  &
    + RC(44) * X(C2H4,1)  &
    + RC(46) * X(C3H6,1)  &
    + DJ(1)  &
    + DJ(2)
  
  F(O3)= P - L*X(O3,1)


!-> NO

  P = DJ(3) * X(NO2,1)  &
    + DJ(13) * X(NO3,1)  &
    + DJ(17) * X(HONO,1)
  
  L = RC(3) * X(OP,1)  &
    + RC(5) * X(O3,1)  &
    + RC(9) * X(NO3,1)  &
    + RC(10) * X(HO2,1)  &
    + RC(22) * X(OH,1)  &
    + RC(25) * X(CH3O2,1)  &
    + RC(34) * X(C2H5O2,1)  &
    + RC(38) * X(CH3COO2,1)  &
    + RC(41) * X(secC4H9O2,1)  &
    + RC(41) * X(CH3COCHO2CH3,1)  &
    + RC(41) * X(CH2O2CH2OH,1)  &
    + RC(41) * X(CH3CHO2CH2OH,1)  &
    + RC(41) * X(oXylOHO2,1)  &
    + RC(41) * X(MemalO2,1)  &
    + RC(41) * X(IsopO2,1)  &
    + RC(51) * X(MVKO2,1)
  
  F(NO)= P - L*X(NO,1)


!-> NO2

  P = RC(3) * X(OP,1) * X(NO,1)  &
    + RC(5) * X(O3,1) * X(NO,1)  &
    + RC(9) * X(NO,1) * X(NO3,1)  &
    + RC(9) * X(NO,1) * X(NO3,1)  &
    + RC(10) * X(NO,1) * X(HO2,1)  &
    + 3.5e-12 * X(NO3,1) * X(HO2,1)  &
    + RC(13) * X(N2O5,1)  &
    + RC(21) * X(OH,1) * X(HONO,1)  &
    + RC(25) * X(CH3O2,1) * X(NO,1)  &
    + 1.3e-12 * X(CH3O2,1) * X(NO3,1)  &
    + RC(34) * X(C2H5O2,1) * X(NO,1)  &
    + 2.3e-12 * X(C2H5O2,1) * X(NO3,1)  &
    + RC(37) * X(PAN,1)  &
    + RC(38) * X(CH3COO2,1) * X(NO,1)  &
    + RC(41) * X(NO,1) * X(secC4H9O2,1)  &
    + RC(41) * X(CH3COCHO2CH3,1) * X(NO,1)  &
    + RC(41) * X(CH2O2CH2OH,1) * X(NO,1)  &
    + RC(41) * X(NO,1) * X(CH3CHO2CH2OH,1)  &
    + RC(41) * X(oXylOHO2,1) * X(NO,1)  &
    + RC(41) * X(MemalO2,1) * X(NO,1)  &
    + RC(41) * X(IsopO2,1) * X(NO,1)  &
    + RC(51) * X(MVKO2,1) * X(NO,1)  &
    + DJ(5) * X(HNO3,1)  &
    + DJ(14) * X(NO3,1)  &
    + DJ(15) * X(N2O5,1)
  
  L = RC(6) * X(O3,1)  &
    + RC(11) * X(NO3,1)  &
    + RC(12) * X(OH,1)  &
    + RC(36) * X(CH3COO2,1)  &
    + DJ(3)
  
  F(NO2)= P - L*X(NO2,1)


!-> PAN

  P = RC(36) * X(CH3COO2,1) * X(NO2,1)
  
  L = RC(37)
  
  F(PAN)= P - L*X(PAN,1)


!-> NO3

  P = RC(6) * X(O3,1) * X(NO2,1)  &
    + RC(13) * X(N2O5,1)  &
    + RC(19) * X(OH,1) * X(HNO3,1)  &
    + DJ(15) * X(N2O5,1)
  
  L = RC(9) * X(NO,1)  &
    + 3.5e-12 * X(HO2,1)  &
    + RC(11) * X(NO2,1)  &
    + 1.3e-12 * X(CH3O2,1)  &
    + RC(31) * X(HCHO,1)  &
    + 2.3e-12 * X(C2H5O2,1)  &
    + DJ(13)  &
    + DJ(14)
  
  F(NO3)= P - L*X(NO3,1)


!-> N2O5

  P = RC(11) * X(NO2,1) * X(NO3,1)
  
  L = RC(13)  &
    + DJ(15)
  
  F(N2O5)= P - L*X(N2O5,1)


!-> HNO3

  P = RC(12) * X(NO2,1) * X(OH,1)  &
    + RC(31) * X(NO3,1) * X(HCHO,1)
  
  L = RC(19) * X(OH,1)  &
    + DJ(5)
  
  F(HNO3)= P - L*X(HNO3,1)


!-> HONO

  P = RC(22) * X(OH,1) * X(NO,1)
  
  L = RC(21) * X(OH,1)  &
    + DJ(17)
  
  F(HONO)= P - L*X(HONO,1)


!-> CH3COO2

  P = 0.95* RC(35) * X(OH,1) * X(CH3CHO,1)  &
    + RC(37) * X(PAN,1)  &
    + RC(41) * X(CH3COCHO2CH3,1) * X(NO,1)  &
    + RC(47) * X(OH,1) * X(CH3COCHO,1)  &
    + DJ(9) * X(CH3COC2H5,1)  &
    + DJ(11) * X(CH3COCHO,1)
  
  L = RC(36) * X(NO2,1)  &
    + RC(38) * X(NO,1)
  
  F(CH3COO2)= P - L*X(CH3COO2,1)


!-> MVKetone

  P = RC(41) * X(IsopO2,1) * X(NO,1)
  
  L = RC(50) * X(OH,1)
  
  F(MVKetone)= P - L*X(MVKetone,1)


!-> HCOCHO

  P = RC(41) * X(MemalO2,1) * X(NO,1)
  
  L = RC(48) * X(OH,1)  &
    + DJ(12)
  
  F(HCOCHO)= P - L*X(HCOCHO,1)


!-> CH3COCHO

  P = RC(41) * X(oXylOHO2,1) * X(NO,1)  &
    + RC(41) * X(MemalO2,1) * X(NO,1)  &
    + RC(51) * X(MVKO2,1) * X(NO,1)
  
  L = RC(47) * X(OH,1)  &
    + DJ(11)
  
  F(CH3COCHO)= P - L*X(CH3COCHO,1)


!-> Memaldial

  P = RC(41) * X(oXylOHO2,1) * X(NO,1)
  
  L = 5.58e-11 * X(OH,1)
  
  F(Memaldial)= P - L*X(Memaldial,1)


!-> CH3COC2H5

  P = 0.65* RC(41) * X(NO,1) * X(secC4H9O2,1)
  
  L = RC(42) * X(OH,1)  &
    + DJ(9)
  
  F(CH3COC2H5)= P - L*X(CH3COC2H5,1)


!-> HCHO

  P = 4.0e-17 * X(SO2,1) * X(CH3O2,1)  &
    + RC(25) * X(CH3O2,1) * X(NO,1)  &
    + 1.3e-12 * X(CH3O2,1) * X(NO3,1)  &
    + RC(26) * X(OH,1) * X(CH3OH,1)  &
    + 0.1* RC(27) * X(HO2,1) * X(CH3O2,1)  &
    + RC(28) * X(CH3O2H,1) * X(OH,1)  &
    + 2.* RC(41) * X(CH2O2CH2OH,1) * X(NO,1)  &
    + 1.14* RC(44) * X(C2H4,1) * X(O3,1)  &
    + RC(41) * X(NO,1) * X(CH3CHO2CH2OH,1)  &
    + 0.545* RC(46) * X(O3,1) * X(C3H6,1)  &
    + RC(41) * X(IsopO2,1) * X(NO,1)  &
    + RC(51) * X(MVKO2,1) * X(NO,1)  &
    + 0.1* DJ(12) * X(HCOCHO,1)  &
    + DJ(16) * X(CH3O2H,1)
  
  L = RC(30) * X(OH,1)  &
    + RC(31) * X(NO3,1)  &
    + DJ(6)  &
    + DJ(7)
  
  F(HCHO)= P - L*X(HCHO,1)


!-> CH3CHO

  P = RC(34) * X(C2H5O2,1) * X(NO,1)  &
    + 2.3e-12 * X(C2H5O2,1) * X(NO3,1)  &
    + RC(39) * X(OH,1) * X(C2H5OH,1)  &
    + 0.35* RC(41) * X(NO,1) * X(secC4H9O2,1)  &
    + RC(41) * X(CH3COCHO2CH3,1) * X(NO,1)  &
    + RC(41) * X(NO,1) * X(CH3CHO2CH2OH,1)  &
    + 0.545* RC(46) * X(O3,1) * X(C3H6,1)
  
  L = RC(35) * X(OH,1)  &
    + DJ(8)
  
  F(CH3CHO)= P - L*X(CH3CHO,1)


!-> C2H6

  ! P = 0.0
  
  L = RC(33) * X(OH,1)
  
  F(C2H6)= - L*X(C2H6,1)


!-> nC4H10

  ! P = 0.0
  
  L = RC(40) * X(OH,1)
  
  F(nC4H10)= - L*X(nC4H10,1)


!-> C2H4

  ! P = 0.0
  
  L = RC(43) * X(OH,1)  &
    + RC(44) * X(O3,1)
  
  F(C2H4)= - L*X(C2H4,1)


!-> C3H6

  ! P = 0.0
  
  L = RC(45) * X(OH,1)  &
    + RC(46) * X(O3,1)
  
  F(C3H6)= - L*X(C3H6,1)


!-> oXylene

  ! P = 0.0
  
  L = 1.36e-11 * X(OH,1)
  
  F(oXylene)= - L*X(oXylene,1)


!-> Isoprene

  ! P = 0.0
  
  L = RC(49) * X(OH,1)
  
  F(Isoprene)= - L*X(Isoprene,1)


!-> CH3O2H

  P = 0.9* RC(27) * X(HO2,1) * X(CH3O2,1)
  
  L = RC(28) * X(OH,1)  &
    + RC(29) * X(OH,1)  &
    + DJ(16)
  
  F(CH3O2H)= P - L*X(CH3O2H,1)


!-> H2O2

  P = RC(17) * X(HO2,1) * X(HO2,1)  &
    + RC(18) * X(HO2,1) * X(HO2,1)  &
    + 0.14* RC(44) * X(C2H4,1) * X(O3,1)  &
    + 0.09* RC(46) * X(O3,1) * X(C3H6,1)
  
  L = RC(16) * X(OH,1)  &
    + DJ(4)
  
  F(H2O2)= P - L*X(H2O2,1)


!-> CH3OH

  ! P = 0.0
  
  L = RC(26) * X(OH,1)
  
  F(CH3OH)= - L*X(CH3OH,1)


!-> C2H5OH

  ! P = 0.0
  
  L = RC(39) * X(OH,1)
  
  F(C2H5OH)= - L*X(C2H5OH,1)


!-> H2

  P = DJ(7) * X(HCHO,1)
  
  L = RC(14) * X(OH,1)
  
  F(H2)= P - L*X(H2,1)


!-> CO

  P = RC(30) * X(OH,1) * X(HCHO,1)  &
    + RC(31) * X(NO3,1) * X(HCHO,1)  &
    + 0.05* RC(35) * X(OH,1) * X(CH3CHO,1)  &
    + 0.63* RC(44) * X(C2H4,1) * X(O3,1)  &
    + 0.56* RC(46) * X(O3,1) * X(C3H6,1)  &
    + RC(47) * X(OH,1) * X(CH3COCHO,1)  &
    + RC(48) * X(OH,1) * X(HCOCHO,1)  &
    + RC(48) * X(OH,1) * X(HCOCHO,1)  &
    + DJ(6) * X(HCHO,1)  &
    + DJ(7) * X(HCHO,1)  &
    + DJ(8) * X(CH3CHO,1)  &
    + DJ(11) * X(CH3COCHO,1)  &
    + 1.9* DJ(12) * X(HCOCHO,1)
  
  L = RC(32) * X(OH,1)
  
  F(CO)= P - L*X(CO,1)


!-> CH4

  P = 0.1* RC(46) * X(O3,1) * X(C3H6,1)
  
  L = RC(24) * X(OH,1)
  
  F(CH4)= P - L*X(CH4,1)


!-> SO2

  ! P = 0.0
  
  L = RC(20) * X(OH,1)  &
    + 4.0e-17 * X(CH3O2,1)
  
  F(SO2)= - L*X(SO2,1)


!-> Sulphate

  P = RC(20) * X(SO2,1) * X(OH,1)  &
    + 4.0e-17 * X(SO2,1) * X(CH3O2,1)
  
  L = RC(23)
  
  F(Sulphate)= P - L*X(Sulphate,1)


