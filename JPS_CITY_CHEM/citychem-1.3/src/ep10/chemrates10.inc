! Generated by GenChem.py - DO NOT EDIT

  RC(1) = 5.67e-34*(TEMP/300.0)**(-2.8)*M*O2
  RC(2) = 0.21*3.2e-11*M*EXP(67.0*TINV)+0.79*1.8e-11*M*EXP(107.0*TINV)
  RC(3) = IUPAC_TROE(1.0e-31*EXP(1.6*LOG300DIVT),  &
        & 3.0e-11*EXP(-0.3*LOG300DIVT),  &
        & 0.85,  &
        & M,  &
        & 0.75-1.27*LOG10(0.85))
  RC(4) = 2.2e-10*H2O
  RC(5) = 1.4e-12*EXP(-1310.0*TINV)
  RC(6) = 1.7e-12*EXP(-940.0*TINV)
  RC(7) = 2.03e-16*EXP(-4.57*LOG300DIVT)*EXP(693.0*TINV)
  RC(8) = 3.6e-12*EXP(270.0*TINV)
  RC(9) = IUPAC_TROE(3.3e-30*EXP(3.0*LOG300DIVT),  &
        & 4.1e-11,  &
        & 0.40,  &
        & M,  &
        & 0.75-1.27*LOG10(0.4))
  RC(10) = 1.25e-17*(TEMP**2)*EXP(615.0*TINV)
  RC(11) = 1.44e-13+M*3.43e-33
  RC(12) = RC(160)
  RC(13) = RC(162)
  RC(14) = RC(163)
  RC(15) = RC(166)
  RC(16) = RC(181)
  RC(17) = RC(182)
