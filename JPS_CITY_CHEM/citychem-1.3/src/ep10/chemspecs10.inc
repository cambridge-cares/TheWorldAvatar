! Generated by GenChem.py - DO NOT EDIT


!+ Defines indices and M,O2,H2O :

integer, parameter :: M   =11
integer, parameter :: O2  =12
integer, parameter :: H2O =13

integer, parameter :: &
  OP          =   1  &
  , OD          =   2  &
  , OH          =   3  &
  , HO2         =   4  &
  , O3          =   5  &
  , NO          =   6  &
  , NO2         =   7  &
  , HNO3        =   8  &
  , HCHO        =   9  &
  , CO          =  10
  
  !+
  ! If zero timestep then we need to do nothing
  
  IF (DTP .LE. 0.) RETURN
  
  ! Set number of Gauss-Seidel iterations of the
  ! implicit Euler and the BDF second order method
  
  NrGSEul = 2
  NrGSBDF = 2
  
  ! Set absolute (mol/cm3) and relative (%/100) error
  ! tolerances
  
  DO NS = 1,NSPEC
    RTOL(NS) = 0.10
  ENDDO
  
  ATOLF = 1.0
  
  !+
  ! Assigns ATOL
  !+
  ATOL(OP          ) = 1.00e+15*ATOLF 
  ATOL(OD          ) = 1.00e+15*ATOLF 
  ATOL(OH          ) = 1.00e+15*ATOLF 
  ATOL(HO2         ) = 1.00e+15*ATOLF 
  ATOL(O3          ) = 5.00e+10*ATOLF 
  ATOL(NO          ) = 2.50e+08*ATOLF 
  ATOL(NO2         ) = 2.50e+09*ATOLF 
  ATOL(HNO3        ) = 2.50e+08*ATOLF 
  ATOL(HCHO        ) = 2.50e+09*ATOLF 
  ATOL(CO          ) = 1.00e+15*ATOLF 
