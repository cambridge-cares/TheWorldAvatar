! Generated by GenChem.py - DO NOT EDIT

!-> OP

  P = RC(2) * X(OD,1)  &
    + DJ(2) * X(O3,1)  &
    + DJ(3) * X(NO2,1)
  
  L = RC(1)  &
    + RC(3) * X(NO,1)
  
  F(OP)= P - L*X(OP,1)


!-> OD

  P = DJ(1) * X(O3,1)
  
  L = RC(2)  &
    + RC(4)
  
  F(OD)= P - L*X(OD,1)


!-> OH

  P = 2.* RC(4) * X(OD,1)  &
    + RC(7) * X(O3,1) * X(HO2,1)  &
    + RC(8) * X(NO,1) * X(HO2,1)  &
    + DJ(5) * X(HNO3,1)
  
  L = RC(6) * X(O3,1)  &
    + RC(9) * X(NO2,1)  &
    + RC(10) * X(HCHO,1)  &
    + RC(11) * X(CO,1)
  
  F(OH)= P - L*X(OH,1)


!-> HO2

  P = RC(6) * X(O3,1) * X(OH,1)  &
    + RC(10) * X(OH,1) * X(HCHO,1)  &
    + RC(11) * X(OH,1) * X(CO,1)  &
    + 2* DJ(6) * X(HCHO,1)
  
  L = RC(7) * X(O3,1)  &
    + RC(8) * X(NO,1)
  
  F(HO2)= P - L*X(HO2,1)


!-> O3

  P = RC(1) * X(OP,1)
  
  L = RC(5) * X(NO,1)  &
    + RC(6) * X(OH,1)  &
    + RC(7) * X(HO2,1)  &
    + DJ(1)  &
    + DJ(2)  &
    + RC(12)
  
  F(O3)= P - L*X(O3,1)


!-> NO

  P = DJ(3) * X(NO2,1)
  
  L = RC(3) * X(OP,1)  &
    + RC(5) * X(O3,1)  &
    + RC(8) * X(HO2,1)
  
  F(NO)= P - L*X(NO,1)


!-> NO2

  P = RC(3) * X(OP,1) * X(NO,1)  &
    + RC(5) * X(O3,1) * X(NO,1)  &
    + RC(8) * X(NO,1) * X(HO2,1)  &
    + DJ(5) * X(HNO3,1)
  
  L = RC(9) * X(OH,1)  &
    + DJ(3)  &
    + RC(13)
  
  F(NO2)= P - L*X(NO2,1)


!-> HNO3

  P = RC(9) * X(NO2,1) * X(OH,1)
  
  L = DJ(5)  &
    + RC(14)  &
    + RC(16)
  
  F(HNO3)= P - L*X(HNO3,1)


!-> HCHO

  ! P = 0.0
  
  L = RC(10) * X(OH,1)  &
    + DJ(6)  &
    + DJ(7)  &
    + RC(17)
  
  F(HCHO)= - L*X(HCHO,1)


!-> CO

  P = RC(10) * X(OH,1) * X(HCHO,1)  &
    + DJ(6) * X(HCHO,1)  &
    + DJ(7) * X(HCHO,1)
  
  L = RC(11) * X(OH,1)  &
    + RC(15)
  
  F(CO)= P - L*X(CO,1)


